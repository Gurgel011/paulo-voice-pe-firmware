## main/Kconfig.projbuild
```kconfig
menu "Paulo Voice PE"

config APP_WIFI_SSID
    string "Wi-Fi SSID"
    default ""

config APP_WIFI_PASSWORD
    string "Wi-Fi password"
    default ""

config APP_SERVER_BASE_URL
    string "Servidor local"
    default "http://192.0.2.10:8091"

config APP_DEVICE_ID
    string "Device ID"
    default "voice-pe-paulo"

config APP_DEVICE_NAME
    string "Device name"
    default "Assistente de Voz do Paulo"

config APP_ENABLE_OUTBOUND_REGISTER
    bool "Registrar no servidor por POST direto"
    default n

endmenu
```

## sdkconfig.defaults
```kconfig
CONFIG_IDF_TARGET="esp32s3"
CONFIG_IDF_TARGET_ESP32S3=y
CONFIG_ESPTOOLPY_FLASHSIZE_16MB=y
CONFIG_ESPTOOLPY_FLASHSIZE="16MB"
CONFIG_ESPTOOLPY_FLASHFREQ_80M=y
CONFIG_ESPTOOLPY_FLASHFREQ="80m"
CONFIG_SPIRAM=y
CONFIG_SPIRAM_MODE_OCT=y
CONFIG_SPIRAM_SPEED_80M=y
CONFIG_FREERTOS_HZ=1000
CONFIG_LOG_DEFAULT_LEVEL_INFO=y
CONFIG_ESP_CONSOLE_USB_SERIAL_JTAG=y
# CONFIG_ESP_CONSOLE_UART_DEFAULT is not set
# CONFIG_ESP_CONSOLE_SECONDARY_USB_SERIAL_JTAG is not set
CONFIG_APP_WIFI_SSID="Antena  1  94.7  FM"
CONFIG_APP_WIFI_PASSWORD="nat13server13"
CONFIG_APP_SERVER_BASE_URL="http://192.168.2.160:8091"
CONFIG_APP_DEVICE_ID="voice-pe-paulo"
CONFIG_APP_DEVICE_NAME="Assistente de Voz do Paulo"
# CONFIG_APP_ENABLE_OUTBOUND_REGISTER is not set
```
